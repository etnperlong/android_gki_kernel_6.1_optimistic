## drivers/block/zram_ext/Kconfig
```kconfig
# SPDX-License-Identifier: GPL-2.0
config ZRAM_EXT
	tristate "Compressed RAM block device with writeback (zram_ext)"
	depends on ZRAM && m
	select ZSMALLOC
	help
	  A copy of the zram driver, built as the zram_ext module with
	  writeback to a backing device, per-slot access time tracking and
	  recompression with secondary algorithms always enabled. GKI builds
	  zram.ko without CONFIG_ZRAM_WRITEBACK, CONFIG_ZRAM_MEMORY_TRACKING
	  and (on 6.1) recompression, and a vendor module cannot change that,
	  so devices that need them load zram_ext.ko instead of zram.ko. Both
	  register the same block device and the same zram-control class:
	  only one of them can be loaded.

	  The default compressor is the one chosen for ZRAM.

	  See Documentation/admin-guide/blockdev/zram.rst for the interface.
```

## drivers/rekernel/Kconfig
```kconfig
menu "Re:Kernel"

config REKERNEL
	bool "Re:Kernel support"
	depends on NET
	default y
	help
	  Report binder transactions and fatal signals aimed at frozen
	  tasks over a netlink socket, so that a userspace daemon can
	  thaw the target before it is killed.  Make tombstone users get
	  a better experience.

config REKERNEL_NETWORK
	bool "Re:Kernel NetReceive unfreeze support"
	depends on REKERNEL && NETFILTER
	default y
	help
	  Also report inbound TCP segments carrying payload, SYN, FIN or
	  RST that are destined for an application uid, so that a frozen
	  application can be thawed for incoming traffic.  This installs
	  an NF_INET_LOCAL_IN hook on the ipv4 and ipv6 families.

endmenu
```

## security/baseband_guard/Kconfig
```kconfig
# SPDX-License-Identifier: GPL-2.0-only
menu "Baseband Guard"

config BBG
	bool "Baseband Guard block device write protection"
	depends on SECURITY && SECURITY_SELINUX && BLOCK
	default n
	help
	  Deny writes, attribute changes and destructive ioctls on block
	  devices that are not on a small allowlist, for processes that
	  descend from an execve into an su, ksu or magisk SELinux domain.

	  The allowlist covers the partitions a root user has a legitimate
	  reason to rewrite - boot, dtbo, the vbmeta set, userdata,
	  metadata, misc and cache - plus zram.  Everything else, including
	  preloader, lk, tee, the modem images and the raw disks, becomes
	  read-only for root.  Processes that never exec through a root
	  domain, such as update_engine or a vendor HAL, are unaffected.

	  This requires "baseband_guard" in CONFIG_LSM, listed after
	  "selinux" so that SELinux keeps cred blob offset 0.  The build
	  fails with an explicit error if it is missing.

	  This is a guard against destructive mistakes, not a privilege
	  boundary: anything able to load a module or write kernel memory
	  can switch it off.

	  If unsure, say N.

config BBG_BLOCK_BOOT
	bool "Also protect boot, init_boot, vendor_boot and vendor_kernel_boot"
	depends on BBG
	default n
	help
	  Remove the boot images from the allowlist.  Flashing a kernel
	  from a running Android system then stops working; recovery,
	  fastbootd and the bootloader remain the only way in.

	  If unsure, say N.

config BBG_BLOCK_RECOVERY
	bool "Also protect recovery"
	depends on BBG
	default n
	help
	  Remove the recovery partition from the allowlist.  Flashing a
	  custom recovery from a running Android system then stops working.

	  If unsure, say N.

endmenu
```
